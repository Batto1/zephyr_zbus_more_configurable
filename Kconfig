## app/zbus_more_configurable/Kconfig
```kconfig
# Copyright (c) 2022 Rodrigo Peixoto <rodrigopex@gmail.com>
# SPDX-License-Identifier: Apache-2.0

menuconfig ZBUS_MORE_CONFIG
	bool "Zbus support with more configuration options"
	help
	  Enables support for Zephyr message bus with more configuration options.

if ZBUS_MORE_CONFIG

config ZBUS_MORE_CONFIG_CHANNELS_SYS_INIT_PRIORITY
	default 5
	int "The priority used during the SYS_INIT procedure."

config ZBUS_MORE_CONFIG_CHANNEL_NAME
	bool "Channel name field"

config ZBUS_MORE_CONFIG_OBSERVER_NAME
	bool "Observer name field"

config ZBUS_MORE_CONFIG_MSG_SUBSCRIBER
	select NET_BUF
	bool "Message subscribers will receive all messages in sequence."

if ZBUS_MORE_CONFIG_MSG_SUBSCRIBER

choice
	prompt "ZBus msg_subscribers buffer allocation"

config ZBUS_MORE_CONFIG_MSG_SUBSCRIBER_NET_BUF_DYNAMIC
	bool "Use heap to allocate msg_subscriber buffers data"

config ZBUS_MORE_CONFIG_MSG_SUBSCRIBER_NET_BUF_STATIC
	bool "Use fixed data size for msg_subscriber buffers pool"

endchoice

config ZBUS_MORE_CONFIG_MSG_SUBSCRIBER_NET_BUF_POOL_SIZE
	default 16
	int "The count of net_buf available to be used simutaneously."

if ZBUS_MORE_CONFIG_MSG_SUBSCRIBER_NET_BUF_STATIC

config ZBUS_MORE_CONFIG_MSG_SUBSCRIBER_NET_BUF_STATIC_DATA_SIZE
	int "The size of the biggest message used with ZBus."

endif # ZBUS_MORE_CONFIG_MSG_SUBSCRIBER_NET_BUF_STATIC

endif # ZBUS_MORE_CONFIG_MSG_SUBSCRIBER

config ZBUS_MORE_CONFIG_RUNTIME_OBSERVERS
	bool "Runtime observers support."
	default n

config ZBUS_MORE_CONFIG_ASSERT_MOCK
	bool "Zbus assert mock for test purposes."
	help
	  This configuration enables the developer to change the _ZBUS_ASSERT behavior. When this configuration is
	  enabled, _ZBUS_ASSERT returns -EFAULT instead of assert. It makes it more straightforward to test invalid
	  parameters.

# below lines make possible writing CONFIG_ZBUS_MORE_CONFIG_LOG_LEVEL_INF=y as configuration without explicitly defining them in Kconfig such that logging is re-used.
module = ZBUS_MORE_CONFIG
module-str = zbus_more_configs
source "subsys/logging/Kconfig.template.log_config"

endif # ZBUS_MORE_CONFIG
```
